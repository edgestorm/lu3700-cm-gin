## drivers/broadcast/Kconfig
```kconfig
#menu "TDMB device support"

config LGE_BROADCAST
	default n
	---help---
	  This driver implements the front-end of the Xen virtual
	  keyboard and mouse device driver.  It communicates with a back-end
	  in another domain.


source "drivers/broadcast/lg2102/Kconfig"
#endmenu
```
